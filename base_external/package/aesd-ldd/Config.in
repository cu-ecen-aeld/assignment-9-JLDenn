## base_external/package/aesd-ldd/Config.in
```kconfig
config BR2_PACKAGE_AESD_LDD
	bool "aesd-ldd"
	help
	  Includes the scull component provided in the ldd directory
```

## base_external/package/aesdchar/Config.in
```kconfig
config BR2_PACKAGE_AESDCHAR
	bool "aesdchar"
	help
	  Includes the aesdchar custom driver we wrote in asn3-and-later repo
```
